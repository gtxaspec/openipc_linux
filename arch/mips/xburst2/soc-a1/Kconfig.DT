## arch/mips/xburst2/soc-a1/Kconfig.DT
```kconfig
config DT_A1_TUCANA
	bool "a1 tucana"
config DT_A1_GORILLA
	bool "a1 gorilla"
config DT_A1_CALF
	bool "a1 calf"
config DT_A1_CALF_V12
	bool "a1 calf_v12"
config DT_A1_CALF_V13
	bool "a1 calf_v13"
config DT_A1_CALF_V16
	bool "a1_calf_v16"
```

## arch/mips/xburst2/soc-t41/Kconfig.DT
```kconfig
config DT_T41_MARMOT
    bool "t41 marmot"
config DT_T41_TOMCAT
	bool "t41 tomcat"
```

## drivers/mtd/devices/ingenic_sfc_v2/Kconfig
```kconfig
config INGENIC_SFC_V2
	tristate "Ingenic series SFC driver v2"
	depends on MACH_XBURST || MACH_XBURST2
	help
		SFC driver version v2.0 for Ingenic series SoCs

if INGENIC_SFC_V2

choice
	prompt "the SFC external memory (nor or nand)"
	help
	  Select the SFC external memory

config MTD_INGENIC_SFC_V2_NORFLASH
	bool "Support ingenic sfc-nor"
	depends on INGENIC_SFC_V2

if MTD_INGENIC_SFC_V2_NORFLASH
choice
	prompt "Erase block size"
	help
	  Select nor flash erase block size

config ERASE_SIZE_32K
	bool "sfc-nor 32k erase block"
	depends on MTD_INGENIC_SFC_V2_NORFLASH

config ERASE_SIZE_64K
	bool "sfc-nor 64k erase block"
	depends on MTD_INGENIC_SFC_V2_NORFLASH

endchoice
endif

config MTD_INGENIC_SFC_V2_NANDFLASH
	bool "Support ingenic sfc-nand"
	depends on INGENIC_SFC_V2
	select MTD_NAND

endchoice

choice
	prompt "sfc Mode"
	help
	  Select sfc Mode

config SPI_STANDARD_MODE
	bool "standard spi mode"
	depends on INGENIC_SFC_V2
	help
	  Say Y here to enable spi standard mode

config SPI_QUAD_MODE
	bool "quad spi mode"
	depends on INGENIC_SFC_V2
	help
	  Say Y Here to enable spi QUAD MODE
endchoice

choice
	prompt "SFC Data Mode"
	help
	  Select Data Mode

config SFC_PIO_MODE
	bool "PIO mode"
	depends on INGENIC_SFC_V2
	help
	  Say Y here to enable PIO mode

config SFC_DMA_MODE
	bool "DMA mode"
	depends on INGENIC_SFC_V2
	help
	  Say Y here to enable DMA mode

endchoice

endif
```

## drivers/net/ethernet/ingenic/Kconfig
```kconfig
config JZ_MAC
	tristate "ingenic on-chip MAC support"
	select CRC32
	select RMII
	help
	  This is the driver for JZ on-chip mac device.

choice
	prompt "JZSOC MAC"
	default CONFIG_JZ_MAC_V13

config JZ_MAC_V12
	depends on JZ_MAC
	bool "V12"
	help
	  Select for jz4775

config JZ_MAC_V13
        depends on JZ_MAC
	bool "V13"
	help
	  Select for X1000
endchoice

config JZ_INTERNAL_MAC_PHY
	depends on SOC_T21 && JZ_MAC
	bool "internal phy"
	help
		Select for t21

config JZ_INTERNAL_MAC_PHY_LED_SOFTWARE_CTRL
	depends on JZ_INTERNAL_MAC_PHY
	bool "internal phy led controled by software instead of phy hardware"
	help
		Select for t21

config JZ_MAC_SPEED_LED_SOFTWARE_CTRL
	depends on JZ_INTERNAL_MAC_PHY_LED_SOFTWARE_CTRL
	bool "internal phy speed led controled by software instead of phy hardware"
	help
		Select for t21

config JZ_MAC_MODE
	tristate "ingenic on-chip MAC support mode"
	depends on JZ_MAC
	select CRC32
	select RMII
	select PHYLIB
	select PHY_RESET
	help
	  This is the driver for JZ on-chip mac support mode device.

choice
	prompt "JZSOC MAC mode"
	depends on JZ_MAC_MODE
	default CONFIG_JZ_MAC_MII

config JZ_MAC_MII
	bool "MII"
	help
	  Select Media Independent Interface

config JZ_MAC_GMII
	bool "GMII"
	help
	  Select Gigabit Media Independent Interface

config JZ_MAC_RMII
	bool "RMII"
	help
	  Select Reduced Media Independent Interface

config JZ_MAC_RGMII
	bool "RGMII"
	help
	  Select Reduced Gigabit Media Independent Interface
endchoice

config JZGPIO_PHY_RESET
    bool "PHY_RESET"
	depends on JZ_MAC
	help
	  This is the gpio for phy reset for 4775 net
	  if there is no special porpose
	  do open this item
```
